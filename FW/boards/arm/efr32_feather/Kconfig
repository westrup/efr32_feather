## FW/boards/arm/efr32_feather/Kconfig
```kconfig
# Kconfig - EFR32 FEATHER board configuration
#
# Copyright (c) 2018 Christian Taedcke, Diego Sueiro
#
# SPDX-License-Identifier: Apache-2.0

if BOARD_EFR32_FEATHER

config BOARD_INIT_PRIORITY
	int

	# omit prompt to signify a "hidden" option
	default KERNEL_INIT_PRIORITY_DEFAULT
	help
	  Board initialization priority. This must be bigger than
	  GPIO_GECKO_COMMON_INIT_PRIORITY.

endif # BOARD_EFR32_FEATHER
```

## FW/boards/arm/efr32_feather/Kconfig.board
```kconfig
# Kconfig - EFR32 FEATHER board
#
# Copyright (c) 2018, Diego Sueiro
#
# SPDX-License-Identifier: Apache-2.0
#

config BOARD_EFR32_FEATHER
	bool "SiLabs EFR32-FEATHER (Thunderboard Sense 2)"
	depends on SOC_SERIES_EFR32FG1P
	select SOC_PART_NUMBER_EFR32FG1P133F256GM48
	select HAS_DTS_I2C
```

## FW/boards/arm/efr32_feather/Kconfig.defconfig
```kconfig
# Kconfig - EFR32 FEATHER board
#
# Copyright (c) 2018, Diego Sueiro
#
# SPDX-License-Identifier: Apache-2.0
#

if BOARD_EFR32_FEATHER

config BOARD
	default "efr32_feather"

config CMU_HFXO_FREQ
	default 38400000

config CMU_LFXO_FREQ
	default 32768

if GPIO_GECKO

config GPIO_GECKO_PORTA
	default y

config GPIO_GECKO_PORTD
	default y

config GPIO_GECKO_PORTF
	default y

endif # GPIO_GECKO

endif # BOARD_EFR32_FEATHER
```
